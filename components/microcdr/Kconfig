## components/microcdr/Kconfig
```kconfig
menu "Micro CDR"

config BIG_ENDIANNESSS
    bool "Use big endianness for serialization/deserialization instead."
    default n

endmenu
```

## main/Kconfig.projbuild
```kconfig
# put here your custom config value
menu "Application Configuration"
config ESP_WIFI_SSID
    string "WiFi SSID"
    default "myssid"
    help
	SSID (network name) for the example to connect to.

config ESP_WIFI_PASSWORD
    string "WiFi Password"
    default "mypassword"
    help
	WiFi password (WPA or WPA2) for the example to use.

choice UXR_DISCOVERY_TYPE
    prompt "Discovery via Unicast or Multicast"
    default UXR_DISCOVERY_TYPE_UNICAST
    config UXR_DISCOVERY_TYPE_UNICAST
        bool "Unicast"
    config UXR_DISCOVERY_TYPE_MULTICAST
        bool "Multicast"
endchoice

config UXR_DISCOVERY_PORT
    depends on UXR_DISCOVERY_TYPE_UNICAST
    int "Port to use for discovery"
    default 2000
    range 1 65535

config UXR_DISCOVERY_IP
    depends on UXR_DISCOVERY_TYPE_UNICAST
    string "IP address to attempt discovery"

config UXR_DISCOVERY_ATTEMPTS
    int "Number of attempts to try and find an XRCE Agent"
    default 10

config UXR_DISCOVERY_PERIOD
    int "Period between attemtps to find an XRCE Agent, in milliseconds"
    default 1000
    
endmenu
```
